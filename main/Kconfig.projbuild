## main/Kconfig.projbuild
```kconfig
menu "Swadge Configuration"

	choice BUILD_HARDWARE
		prompt "Select the hardware"
		default HARDWARE_GUNSHIP
		help
			Select the hardware being built for
		config HARDWARE_WAVEBIRD
			bool "HARDWARE_WAVEBIRD"
			depends on IDF_TARGET_ESP32S2
			help
				Build for the Squarewavebird Swadge (2023)
		config HARDWARE_GUNSHIP
			bool "HARDWARE_GUNSHIP"
			depends on IDF_TARGET_ESP32S2
			help
				Build for the Gunship Swadge (2024)
		config HARDWARE_HOTDOG_PROTO
			bool "HARDWARE_HOTDOG_PROTO"
			depends on IDF_TARGET_ESP32S2
			help
				Build for the Protoype Hotdog Swadge (2025)
		config HARDWARE_HOTDOG_PRODUCTION
			bool "HARDWARE_HOTDOG_PRODUCTION"
			depends on IDF_TARGET_ESP32S2
			help
				Build for the Production Hotdog Swadge (2025)
		config HARDWARE_PULSE
			bool "HARDWARE_PULSE"
			depends on IDF_TARGET_ESP32S2
			help
				Build for the Pulse Swadge (2026)
		config HARDWARE_FAIRY_PROTO
			bool "HARDWARE_FAIRY_PROTO"
			depends on IDF_TARGET_ESP32S3
			help
				Build for the prototype Fairy Swadge (2027)
	endchoice

	choice DEBUG_OUTPUT_TYPE
		prompt "Select Debug Output"
		default DEBUG_OUTPUT_USB
		help
			Select debug output (i.e. where printf() goes).
		config DEBUG_OUTPUT_USB
			bool "DEBUG_OUTPUT_USB"
			help
				printf() is sent over USB
		config DEBUG_OUTPUT_UART
			bool "DEBUG_OUTPUT_UART"
			help
				printf() is sent over the default UART pin
		config DEBUG_OUTPUT_UART_SAO
			bool "DEBUG_OUTPUT_UART_SAO"
			help
				printf() is sent over the SAO connector instead of LED mirroring.
	endchoice

	choice SOUND_OUTPUT_TYPE
		prompt "Select Sound Output"
		default SOUND_OUTPUT_SPEAKER
		help
			Select sound output, either the buzzers or the speaker.
		config SOUND_OUTPUT_BUZZER
			bool "SOUND_OUTPUT_BUZZER"
			depends on HARDWARE_WAVEBIRD || HARDWARE_GUNSHIP
			help
				Sound comes out the two buzzers
		config SOUND_OUTPUT_SPEAKER
			bool "SOUND_OUTPUT_SPEAKER"
			depends on HARDWARE_HOTDOG_PROTO || HARDWARE_HOTDOG_PRODUCTION || HARDWARE_PULSE || HARDWARE_FAIRY_PROTO
			help
				Sound comes out the speaker
	endchoice

	choice FACTORY_TEST_TYPE
		prompt "Select Factory Test Type"
		default FACTORY_TEST_NORMAL
		help
			Select factory test mode, either boot to the normal menu or show a warning
		config FACTORY_TEST_NORMAL
			bool "FACTORY_TEST_NORMAL"
			help
				Run tutorial and normal menu after factory test
		config FACTORY_TEST_WARNING
			bool "FACTORY_TEST_WARNING"
			help
				Show a warning after factory test
	endchoice

	config NUM_LEDS
		int "Select the number of RGB LEDs"
		range 6 14
		default 8 if HARDWARE_WAVEBIRD
		default 9 if HARDWARE_GUNSHIP || HARDWARE_HOTDOG_PROTO || HARDWARE_HOTDOG_PRODUCTION
		default 6 if HARDWARE_PULSE
		default 14 if HARDWARE_FAIRY_PROTO

endmenu
```
