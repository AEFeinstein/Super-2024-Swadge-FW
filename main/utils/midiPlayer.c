#include "midiPlayer.h"

#include <string.h>
#include <inttypes.h>

#include "waveTables.h"
#include "hdw-dac.h"
#include "fp_math.h"
#include "esp_log.h"

//==============================================================================
// Generated by tools/midi_freqs.py
//==============================================================================
static const uq16_16 noteFreqTable[] = {
    0x00082d01, // C-2  = 8.176 Hz
    0x0008a976, // C#-2 = 8.662 Hz
    0x00092d51, // D-2  = 9.177 Hz
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    0x30ffda9d, // G8   = 12543.854 Hz
};

// Multiply a frequency by this value to bend it by a number of cents
// uint32_t bentPitch = (uint32_t)(((uint64_t)pitch * bendTable[bendCents + 100]) >> 24)
static const uq24_8 bendTable[] = {
    0x00f1a1bf, // -100 cents => 0.94387
    0x00f1c57d, // -99 cents => 0.94442
    0x00f1e940, // -98 cents => 0.94497
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    0x010f38f9, // +100 cents => 1.05946
};

static const uq16_16 rmsTable[] = {
    0x00000000, // 1 / sqrt(0) = 0.0000
    0x00010000, // 1 / sqrt(1) = 1.0000
    0x0000b504, // 1 / sqrt(2) = 0.7071
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    0x00002dfa, // 1 / sqrt(31) = 0.1796
};
//==============================================================================
// End generated code section
//==============================================================================

// Apply a random offset to each oscillator to maybe make it less likely for waves to "stack" exactly
#define OSC_DITHER
#ifdef OSC_DITHER
static const uint8_t oscDither[] = {
    157,
    34,
    252,
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    226,
};
#endif

// For MIDI values with coarse and fine bytes, each 7 bits
#define UINT14_MAX (0x3FFF)

//#define MIDI_MULTI_STATE
#ifdef MIDI_MULTI_STATE
#define VS_ANY(statePtr) ((statePtr)->attack | (statePtr)->decay | (statePtr)->release | (statePtr)->sustain)
#define VS_RELEASABLE(statePtr) ((statePtr)->attack | (statePtr)->decay | (statePtr)->sustain)
#define VS_HOLDABLE(statePtr) VS_RELEASABLE(statePtr)
#else
#define VS_ANY(statePtr) ((statePtr)->on)
#define VS_RELEASABLE(statePtr) ((statePtr)->on)
#define VS_HOLDABLE(statePtr) ((statePtr)->on)
#endif
#define MS_TO_TICKS(ms) ((ms) * DAC_SAMPLE_RATE_HZ / 1000)


static uint32_t allocVoice(midiPlayer_t* player, voiceStates_t* states, uint8_t voiceCount);
static uq16_16 bendPitch(uint8_t noteId, uint16_t pitchWheel);
static void midiGmOn(midiPlayer_t* player);

static int8_t defaultDrumkitFunc(percussionNote_t drum, uint32_t idx, void* data);

static const midiTimbre_t defaultDrumkitTimbre = {
    .type = NOISE,
    .flags = TF_PERCUSSION,
    .percussion = {
        .playFunc = defaultDrumkitFunc,
        // TODO: Define the data and put it here!
        .data = NULL,
    },
    .envelope = { 0 },
    .name = "Swadge Drums 0",
};

static const midiTimbre_t acousticGrandPianoTimbre = {
    .type = WAVETABLE,
    .flags = TF_NONE,
    .waveIndex = 0,
    .envelope = {
        // TODO: Just realized I forgot how ADSR actually works halfway through writing everything else...
        // So go make sure the rest of everything makes sense, maybe rename everything to {a,d,r}Time and {s}Level for clarity
        // Pretty fast attack
        .attack = MS_TO_TICKS(24),
        // Take a good long while to reach the sustain level
        .decay = MS_TO_TICKS(750),
        // Sustain at about 75% of initial volume
        .sustain = 192,
        // And a not-too-short release time
        .release = MS_TO_TICKS(100),
        // Yup, I'm sure it will sound exactly like a grand piano now!
    },
    .name = "Acoustic Grand Piano",
};

// Check for the first unused note, then try to steal one in order of less to more bad, and return INT32_MAX if none are available
static uint32_t allocVoice(midiPlayer_t* player, voiceStates_t* states, uint8_t voiceCount)
{
#define CHECK_VOICE(val) ((val) ? (__builtin_ctz((val))) : 0)
    uint32_t allStates = VS_ANY(states) | states->held; //states->attack | states->decay | states->release | states->sustain | states->held;

    // Find the first voice index which is not used
    // Oh, this was BACKWARDS
    // I'm always allocating the first voice woops
    // Set up a bitflag which has a 1 set for every voice that is NOT being used
    //                         /- flip the bits so a 1 represents an unused voice and a 0 represents an in-use voice
    //                        /                /- mask the bits to only go up to the number of voices we have
    //                       v                v
    uint32_t unusedVoices = (~allStates) & (0xFFFFFFFFu >> (32 - voiceCount));

    if (unusedVoices != 0)
    {
        // Return whatever the first voice that's not allocated is
        return __builtin_ctz(unusedVoices);
    }
    else
    {
        // Gotta steal a note, so steal the first one
        return 0;
    }

    //return firstFreeIdx;
#undef CHECK_VOICE
}

/**
 * @brief Calculate pitch bend
 *
 * @param noteId The MIDI note ID to bend
 * @param pitchWheel The 14-bit MIDI pitch wheel value
 * @return uint32_t The note frequency as a UQ16.16 value
 */
static uq16_16 bendPitch(uint8_t noteId, uint16_t pitchWheel)
{
    // TODO: Should we have a special case when the pitch wheel is centered? Probably better not to branch at all even if we do a bit of unnecessary math
    // First, convert the pitch wheel value to +/-cents
    int32_t bendCents = (((int16_t)-0x2000) + pitchWheel) * 100 / 0x1FFF;
    uint64_t freq = noteFreqTable[noteId];
    freq *= bendTable[bendCents + 100];
    uq16_16 trimmedFreq = ((freq >> 24) & (0xFFFFFFFFu));
    //ESP_LOGI("MIDI", "Bent note #%d %+dc from freq %08x (%d) to %08x (%d)", noteId, bendCents, noteFreqTable[noteId], noteFreqTable[noteId] >> 16, trimmedFreq, trimmedFreq >> 16);
    return trimmedFreq;
}

/**
 * @brief Activate General MIDI mode for a MIDI player
 *
 * @param player The MIDI player to set to General MIDI mode
 */
static void midiGmOn(midiPlayer_t* player)
{
    bool percOscSetup = false;

    for (uint8_t chanIdx = 0; chanIdx < 16; chanIdx++)
    {
        midiChannel_t* chan = &player->channels[chanIdx];

        chan->volume = UINT14_MAX;
        chan->pitchBend = 0x2000;
        chan->program = 0;

        if (chanIdx == 10)
        {
            // Channel 10 is reserved for percussion.
            chan->percussion = true;

            // TODO: Should we just have a pointer instead? That will work great as long as we don't need to modify the timbre in-place (which MIDI does technically allow)
            memcpy(&chan->timbre, &defaultDrumkitTimbre, sizeof(midiTimbre_t));
        }
        else
        {
            chan->percussion = false;
            memcpy(&chan->timbre, &acousticGrandPianoTimbre, sizeof(midiTimbre_t));
        }

        midiVoice_t* voices = chan->percussion ? player->percVoices : chan->voices;
        uint8_t voiceCount = chan->percussion ? PERCUSSION_VOICES : VOICE_PER_CHANNEL;

        for (uint8_t voiceIdx = 0; voiceIdx < voiceCount; voiceIdx++)
        {
            midiVoice_t* voice = &voices[voiceIdx];

            for (uint8_t oscIdx = 0; oscIdx < OSC_PER_VOICE; oscIdx++)
            {
                switch (voice->timbre.type)
                {
                    case WAVETABLE:
                    {
                        swSynthInitOscillatorWave(&voice->oscillators[oscIdx], waveTableFunc, (void*)((uint32_t)(voice->timbre.waveIndex)), 0, 0);
                        // Apply a random offset to the oscillator so that similar waves aren't exactly in sync
                        // TODO figure out if this does literally anything
#ifdef OSC_DITHER
                        voice->oscillators[oscIdx].accumulator.bytes[3] = (oscDither[player->oscillatorCount]) & 0xFF;
#endif
                        // Make sure we don't count the percussion oscillators multiple times
                        if (!chan->percussion || !percOscSetup)
                        {
                            player->allOscillators[player->oscillatorCount++] = &voice->oscillators[oscIdx];
                        }
                        break;
                    }

                    case SAMPLE:
                    {
                        // TODO: Sample support
                        // player->allSamplers[player->samplerCount++] = ...
                        break;
                    }

                    case NOISE:
                    {
                        swSynthInitOscillator(&voice->oscillators[oscIdx], SHAPE_NOISE, 0, 0);
                        // Apply a random offset to the oscillator so that similar waves aren't exactly in sync
                        // TODO figure out if this does literally anything
#ifdef OSC_DITHER
                        voice->oscillators[oscIdx].accumulator.bytes[3] = (oscDither[player->oscillatorCount]) & 0xFF;
#endif

                        // Make sure we don't count the percussion oscillators multiple times
                        if (!chan->percussion || !percOscSetup)
                        {
                            player->allOscillators[player->oscillatorCount++] = &voice->oscillators[oscIdx];
                        }
                        break;
                    }
                }
            }

            if (chan->percussion)
            {
                // If this was a percussion channel, then all the percussion oscillators were set up
                percOscSetup = true;
            }
        }
    }
    if (player->oscillatorCount > 0)
    {
        player->oscillatorCount--;
    }
}

static int8_t defaultDrumkitFunc(percussionNote_t drum, uint32_t idx, void* data)
{
    switch (drum)
    {
        // TODO drumkit
        default:
        {
            static uint16_t shiftReg = 0xACE1u;

            /* taps: 16 14 13 11; feedback polynomial: x^16 + x^14 + x^13 + x^11 + 1 */
            uint16_t bit = ((shiftReg >> 0) ^ (shiftReg >> 2) ^ (shiftReg >> 3) ^ (shiftReg >> 5)) & 1u;
            shiftReg     = (shiftReg >> 1) | (bit << 15);

            /* This will return as an 8-bit signed value */
            return shiftReg;
        }
    }
}

void midiPlayerInit(midiPlayer_t* player)
{
    // Zero out EVERYTHING
    memset(player, 0, sizeof(midiPlayer_t));
    midiGmOn(player);
}

void midiPlayerFillBuffer(midiPlayer_t* player, uint8_t* samples, int16_t len)
{
    uint16_t activeOsc = activeOsc = player->activeOscillators;

    for (int16_t n = 0; n < len; n++)
    {
        // TODO: Sample support
        // sample += samplerSumSamplers(player->allSamplers, player->samplerCount)
        int32_t sample = swSynthSumOscillators(player->allOscillators, player->oscillatorCount);

        sample *= rmsTable[activeOsc];
        sample >>= 16;

        if (sample < -128)
        {
            samples[n] = 0;
            player->clipped++;
        }
        else if (sample > 127)
        {
            samples[n] = 255;
            player->clipped++;
        }
        else
        {
            samples[n] = sample + 128;
        }

    }
}

void midiAllSoundOff(midiPlayer_t* player)
{
    // TODO: It is unclear whether this applies to every channel or just one
    // Seems like people "agree" it's special and applies to every channel
    // But also people say the spec is deficient in this area.
    // So if it's up to us, let's just do them all!

    for (int chanIdx = 0; chanIdx < 16; chanIdx++)
    {
        midiChannel_t* chan = &player->channels[chanIdx];
        // Here we don't bother to check whether this channel is using its own voices
        // or the percussion voices, since we want to turn them off no matter what.
        // This is because All Sounds Off is often used as a "panic" button to stop any
        // stuck notes. So just in case we get into a bad state where notes are playing
        // but we don't think they are, this will always stop them anyway.
        for (uint8_t voiceIdx = 0; voiceIdx < VOICE_PER_CHANNEL; voiceIdx++)
        {
            // TODO: Maybe move this all into a stopVoice() function
            chan->voices[voiceIdx].transitionTicks = 0;
            chan->voices[voiceIdx].targetVol = 0;
            chan->voiceStates.held = 0;
            chan->voiceStates.on = 0;
            // TODO: Handle samplers
            for (uint8_t oscIdx = 0; oscIdx < OSC_PER_VOICE; oscIdx++)
            {
                swSynthSetVolume(&chan->voices[voiceIdx].oscillators[oscIdx], 0);
                swSynthSetFreqPrecise(&chan->voices[voiceIdx].oscillators[oscIdx], 0);
            }
        }
    }

    for (uint8_t voiceIdx = 0; voiceIdx < PERCUSSION_VOICES; voiceIdx++)
    {
        player->percVoices[voiceIdx].transitionTicks = 0;
        player->percVoiceStates.held = 0;
        player->percVoiceStates.on = 0;
        // TODO: Handle samplers
        for (uint8_t oscIdx = 0; oscIdx < OSC_PER_VOICE; oscIdx++)
        {
            player->percVoices[voiceIdx].targetVol = 0;
            swSynthSetVolume(&player->percVoices[voiceIdx].oscillators[oscIdx], 0);
            swSynthSetFreqPrecise(&player->percVoices[voiceIdx].oscillators[oscIdx], 0);
        }
    }

    player->activeOscillators = 0;
}


void midiAllNotesOff(midiPlayer_t* player, uint8_t channel)
{
    midiChannel_t* chan = &player->channels[channel];
    voiceStates_t* states = chan->percussion ? &player->percVoiceStates : &chan->voiceStates;

    uint32_t playingVoices = VS_ANY(states) | states->held;
    while (playingVoices != 0)
    {
        // TODO / FIXME: This causes an additional search for the playing channel which is unnecessary
        // Instead, refactor the core of midiNoteOff() into an internal midiVoiceOff() function
        // That's probably a good idea anyway with how complicated midiNoteOff() is getting
        uint8_t voiceIdx = __builtin_ctz(playingVoices);
        midiNoteOff(player, channel, chan->voices[voiceIdx].note, 0x7F);
    }
}


void midiNoteOn(midiPlayer_t* player, uint8_t chanId, uint8_t note, uint8_t velocity)
{
    if (velocity == 0)
    {
        // MIDI note on with a value of 0 is considered a note off
        midiNoteOff(player, chanId, note, 0x7F);
        return;
    }

    midiChannel_t* chan = &player->channels[chanId];
    // Use the appropriate voice pool for the instrument type
    // Percussion gets its own
    voiceStates_t* states = chan->percussion ? &player->percVoiceStates : &chan->voiceStates;
    midiVoice_t* voices = chan->percussion ? player->percVoices : chan->voices;
    uint8_t voiceCount = chan->percussion ? PERCUSSION_VOICES : VOICE_PER_CHANNEL;
    uint32_t voiceIdx = (chan->timbre.flags & TF_MONO) ? 0 : allocVoice(player, states, voiceCount);

    if (voiceIdx >= voiceCount)
    {
        // no voices available and we couldn't find an appropriate one to steal
        // if this happens often we should just allocate more voices
        // (or make the stealing algorithm always succeed)
        return;
    }

    uint32_t voiceBit = (1 << voiceIdx);

    if (!((states->on | states->held) & voiceBit))
    {
        // This voice is being activated when it wasn't previously (not stolen from an already-playing note)
        player->activeOscillators += OSC_PER_VOICE;
    }

    states->on |= voiceBit;
    voices[voiceIdx].note = note;

    // TODO: Add a note -> voice map in the channel?
    uint8_t targetVol = velocity << 1 | 1;

    switch (chan->timbre.type)
    {
        case WAVETABLE:
        case NOISE:
        {
            // TODO: velocity should affect attack time instead of directly affecting volume
            swSynthSetVolume(&voices[voiceIdx].oscillators[0], targetVol);
            swSynthSetFreqPrecise(&voices[voiceIdx].oscillators[0], bendPitch(note, chan->pitchBend));
            voices[voiceIdx].targetVol = targetVol;

            //ESP_LOGI("MIDI", "Velocity is %" PRIu8, velocity << 1);
            //voices[voiceIdx].transitionTicks = chan->timbre.envelope.attack;
            break;
        }

        case SAMPLE:
        {
            // TODO: Sample support!
            break;
        }
    }
}


void midiNoteOff(midiPlayer_t* player, uint8_t channel, uint8_t note, uint8_t velocity)
{
    midiChannel_t* chan = &player->channels[channel];
    voiceStates_t* states = chan->percussion ? &player->percVoiceStates : &chan->voiceStates;
    midiVoice_t* voices = chan->percussion ? player->percVoices : chan->voices;

    // check the bitmaps to see if there's any note to release
    uint32_t playingVoices = VS_ANY(&chan->voiceStates) | chan->voiceStates.held;


    // Find the channel playing this note
    while (playingVoices != 0)
    {
        uint8_t voiceIdx = __builtin_ctz(playingVoices);
        uint32_t voiceBit = (1 << voiceIdx);

        if (voices[voiceIdx].note == note)
        {
            // This is the one we want!
            // If this oscillator isn't already off, decrease the active count
            if (playingVoices & voiceBit)
            {
                player->activeOscillators -= OSC_PER_VOICE;
            }

            // Unset the on-ness of this note
            states->on &= ~voiceBit;
            if (chan->held)
            {
                states->held |= voiceBit;
            }
            else
            {
                voices[voiceIdx].targetVol = 0;
                for (uint8_t i = 0; i < OSC_PER_VOICE; i++)
                {
                    swSynthSetVolume(&voices[voiceIdx].oscillators[i], 0);
                }
            }

            return;
        }

        // Move on to the next voice
        playingVoices &= ~voiceBit;
    }
}

void midiSetProgram(midiPlayer_t* player, uint8_t channel, uint8_t program)
{
    // TODO: Handle Set Program
    // TODO: If a channel is set to/unset from percussion make sure we update allOscillators
    player->channels[channel].program = program;

    midiChannel_t* chan = &player->channels[channel];
    midiVoice_t* voices = chan->percussion ? player->percVoices : chan->voices;
    voiceStates_t* states = chan->percussion ? &player->percVoiceStates : &chan->voiceStates;
    uint8_t voiceCount = chan->percussion ? PERCUSSION_VOICES : VOICE_PER_CHANNEL;

    for (uint8_t voiceIdx = 0; voiceIdx < voiceCount; voiceIdx++)
    {
        midiVoice_t* voice = &voices[voiceIdx];

        // If these oscillators were active, mark them as active
        if ((states->held | states->on) & (1 << voiceIdx))
        {
            player->activeOscillators -= OSC_PER_VOICE;
        }

        for (uint8_t oscIdx = 0; oscIdx < OSC_PER_VOICE; oscIdx++)
        {
            swSynthSetVolume(&voice->oscillators[oscIdx], 0);
            swSynthSetWaveFunc(&voice->oscillators[oscIdx], waveTableFunc, (void*)((uint32_t)program));
        }
    }
}


void midiSustain(midiPlayer_t* player, uint8_t channel, uint8_t val)
{
    midiChannel_t* chan = &player->channels[channel];
    bool newHold = MIDI_TO_BOOL(val);

    if (chan->held != newHold)
    {
        voiceStates_t* voiceStates = chan->percussion ? &player->percVoiceStates : &chan->voiceStates;
        midiVoice_t* voices = chan->percussion ? player->percVoices : chan->voices;
        if (newHold)
        {
            // Just set the held state for all the currently on notes.
            voiceStates->held |= voiceStates->on;
        }
        else
        {
            // for now what we do is just, if the note is held and not on, turn it off
            // if the note is on, just unset held
            // We should cancel all the notes which are not currently being held
            uint32_t notesToCancel = voiceStates->held & ~(voiceStates->on);

            // unset the hold flag for all
            // TODO: Isn't this going to always be 0?
            uint32_t newHold = (voiceStates->held & ~notesToCancel);

            while (notesToCancel != 0)
            {
                uint8_t voiceIdx = __builtin_ctz(notesToCancel);
                uint32_t voiceBit = (1 << voiceIdx);

                if ((voiceStates->held | voiceStates->on) & voiceBit)
                {
                    // TODO: Can we skip this conditional since notesToCancel should only contain voices which were already on?
                    player->activeOscillators -= OSC_PER_VOICE;
                }

                // unset the note's bit and move on to the next one
                notesToCancel &= ~voiceBit;

                for (uint8_t i = 0; i < OSC_PER_VOICE; i++)
                {
                    swSynthSetVolume(&voices[voiceIdx].oscillators[i], 0);
                }
            }

            voiceStates->held = newHold;
        }
        chan->held = newHold;
    }
}


void midiControlChange(midiPlayer_t* player, uint8_t channel, uint8_t control, uint8_t val)
{
    midiAllNotesOff(player, channel);
    // TODO maybe some sort of resetChannel() function?
}


void midiPitchWheel(midiPlayer_t* player, uint8_t channel, uint16_t value)
{
    // Save the pitch bend value
    player->channels[channel].pitchBend = value;

    // Find all the voices currently sounding and update their frequencies
    uint32_t playingVoices = VS_ANY(&player->channels[channel].voiceStates) | player->channels[channel].voiceStates.held;

    // Thought this was a bug but actually
    while (playingVoices != 0)
    {
        uint8_t voiceIdx = __builtin_ctz(playingVoices);
        uint32_t voiceBit = (1 << voiceIdx);

        for (uint8_t oscIdx = 0; oscIdx < OSC_PER_VOICE; oscIdx++)
        {
            // Apply the pitch bend to all this channel's oscillators
            // TODO: If each voice has multiple oscillators, we would obviously
            // want to be able to control them separately here.
            // Maybe we only apply that for like, chorus?
            swSynthSetFreqPrecise(
                &player->channels[channel].voices[voiceIdx].oscillators[oscIdx],
                bendPitch(player->channels[channel].voices[voiceIdx].note, value));
        }

        // Next!
        playingVoices &= ~voiceBit;
    }
}
